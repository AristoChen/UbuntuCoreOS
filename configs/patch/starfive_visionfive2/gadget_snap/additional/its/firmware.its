## configs/patch/starfive_visionfive2/gadget_snap/additional/its/firmware.its
```
/dts-v1/;

/ {
	description = "Ubuntu Core FIT boot firmware";
	#address-cells = <2>;

	images {
		firmware {
			description = "Ubuntu-Core-Bootloader";
			data = /incbin/("./fw_payload.bin");
			type = "firmware";
			arch = "riscv";
			os = "u-boot";
			compression = "none";
			load =  <0x40000000>;
			entry = <0x40000000>;
		};
	};

	configurations {
		default = "firmware-1";

		fimware-1 {
			description = "__DEVICE__ firmware";
			firmware = "firmware";
		};
	};
};
```

## kernel_snap/its/kernel.its
```
/dts-v1/;

/ {
	description = "Ubuntu Core kernel, ramdisk and FDT blobs";
	#address-cells = <1>;

	images {
		kernel-uc {
			description = "Ubuntu-Core-Kernel";
			data = /incbin/("./Image");
			type = "kernel";
			arch = "__ITS_ARCH__";
			os = "linux";
			compression = "__ITS_KERNEL_COMPRESSION__";
			load =  <__KERNEL_LOAD_ADDR__>;
			entry = <__KERNEL_LOAD_ADDR__>;
			hash-1 {
				algo = "sha256";
			};
		};

		ramdisk-uc {
			description = "Ubuntu-Core-Ramdisk";
			data = /incbin/("./initrd.img");
			type = "ramdisk";
			arch = "__ITS_ARCH__";
			os = "linux";
			compression = "none";
			load =  <__RAMDISK_LOAD_ADDR__>;
			entry = <__RAMDISK_LOAD_ADDR__>;
			hash-1 {
				algo = "sha256";
			};
		};

		fdt-uc {
			description = "__DEVICE__ device tree";
			data = /incbin/("./__ITS_FDT_PATH__");
			type = "flat_dt";
			arch = "__ITS_ARCH__";
			compression = "none";
			load =  <__FDT_LOAD_ADDR__>;
			entry = <__FDT_LOAD_ADDR__>;
			hash-1 {
				algo = "sha256";
			};
		};
	};

	configurations {
		default = "__ITS_FDT_NAME__";

		__ITS_FDT_NAME__ {
			description = "__DEVICE__";
			kernel = "kernel-uc";
			ramdisk = "ramdisk-uc";
			fdt = "fdt-uc";
		};
	};
};
```
